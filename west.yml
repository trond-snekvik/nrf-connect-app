## west.yml
```yaml
manifest:
  self:
    path: app

  remotes:
    - name: nrfconnect
      url-base: https://github.com/nrfconnect

  projects:
    - name: nrf
      remote: nrfconnect
      repo-path: sdk-nrf
      revision: v2.5.1
      import: true
```
